## scripts/device_tree/bfvmm.its
```
/dts-v1/;

/ {
    description = "Bareflank VMM payload for Bareflank Bootloader";
    #address-cells = <1>;

    images {

        vmm {
            description = "Bareflank VMM";
            data = /incbin/("bfvmm_static");
            type = "kernel";
            arch = "arm64";
            os = "linux";
            compression = "none";
            load = <0x88000000>;
            entry = <0x88000000>;

            hash@1 {
                algo = "sha1";
            };
        };

    };

    configurations {
        default = "conf@1";

        conf@1 {
            description = "Bareflank Bootloader->Bareflank VMM";
            bfvmm = "bfvmm";
        };
    };
};
```

## scripts/device_tree/bootloader.its
```
/dts-v1/;

/ {
    description = "Bareflank Booloader Flattened Image Tree";
    #address-cells = <1>;

    images {

        bootloader {
            description = "Bareflank Bootloader";
            data = /incbin/("bootloader.bin");
            type = "kernel";
            arch = "arm64";
            os = "linux";
            compression = "none";
            load = <0xf0000000>;
            entry = <0xf0000000>;

            hash@1 {
                algo = "sha1";
            };
        };

        vmm_payload {
            description = "Bareflank Bootloader Payload";
            data = /incbin/("bfvmm_static");
            type = "flat_dt";
            arch = "arm64";
            load = <0xf0100000>;

            compression = "none";
            hash@1 {
                algo = "sha1";
            };
        };

    };

    configurations {
        default = "conf@1";

        conf@1 {
            description = "Discharge->Bareflank Bootloader->Bareflank VMM";
            kernel = "bootloader";
            fdt = "vmm_payload";
        };
    };
};
```

## scripts/device_tree/testcases.its
```
/dts-v1/;

/ {
    description = "Testcase Payload for ScapulaOS";
    #address-cells = <1>;

    images {

        aarch32_testcases {
            description = "Testcases for AArch32 execution";
            data = /incbin/("aarch32_testcases");
            type = "library";
            arch = "arm";
            os = "ScapulaOS";
            compression = "none";
        };

        aarch64_testcases {
            description = "Testcases for AArch64 execution";
            data = /incbin/("aarch64_testcases");
            type = "library";
            arch = "arm64";
            os = "ScapulaOS";
            compression = "none";
        };

    };
};
```
